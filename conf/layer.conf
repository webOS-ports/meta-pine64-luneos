## conf/layer.conf
```bitbake
# We have a conf and classes directory, add to BBPATH
BBPATH .= ":${LAYERDIR}"

# We have a recipes-* directories, add to BBFILES
BBFILES += "${LAYERDIR}/recipes-*/*/*.bb \
	${LAYERDIR}/recipes-*/*/*.bbappend"

BBFILE_COLLECTIONS += "pine64-luneos-layer"
BBFILE_PATTERN_pine64-luneos-layer = "^${LAYERDIR}/"
BBFILE_PRIORITY_pine64-luneos-layer = "7"

LAYERSERIES_COMPAT_pine64-luneos-layer = "honister"

# Don't change PACKAGECONFIg for rk3399, so that we can use the same qtbase for pp and ppp
BBMASK += "meta-rockchip/dynamic-layers/qt5-layer/recipes-qt/qt5/qtbase_%.bbappend"
```

## wic/pinephone-luneos-bsp-image.wks
```
#
# The disk layout used is:
#
#    0                   -> reserverd
#    8 KiB               -> u-boot SPL and u-boot
#    20480 KiB           -> kernel, dtbs, boot script
#    20480 KiB + 50 MiB  -> rootfs
#

# variant with SPL and u-boot
#part spl --source rawcopy --sourceparams="file=u-boot-sunxi-with-spl.bin" --ondisk mmcblk --no-table --align 8
#part /boot --source bootimg-partition --ondisk mmcblk0 --fstype=vfat --label luneos-boot --active --size=100M --align 20480
#part / --source rootfs --ondisk mmcblk0 --fstype=ext4 --size=1000M --label luneos-rootfs --align 4096 --use-uuid

# variant with systemd-boot
part /boot --source bootimg-efi --sourceparams="loader=systemd-boot" --ondisk mmcblk0 --label boot-efi --active --size=100M --align 1024 --use-uuid
part / --source rootfs --ondisk mmcblk0 --fstype=ext4 --size=1000M --label luneos-rootfs --align 4096
bootloader --ptable gpt --timeout=2 --configfile="pinephone-boot.conf"
```

## wic/pinetab2-luneos-bsp-image.wks
```
# Copyright (C) 2019,2020 Garmin Ltd. or its subsidiaries
# Copyright (C) 2021 Trevor Woerner
# Released under the MIT license (see COPYING.MIT for the terms)
#
# Disk layout
# Note that the reference documentation refers to 512 byte disk sectors, but
# wic uses 1KB blocks
#
#   Partition   Start Sector    Number of Sectors
#   loader1     64              8000
#   reserved1   8064            128
#   reserved2   8192            8192
#   loader2     16384           8192
#   atf         24576           8192
#   boot        32768           229376
#   root        262144          -           (suggested)

# Note: adapted from rockchip.wks

part loader1    --offset 32     --fixed-size 4000K            --source rawcopy                                                 --sourceparams="file=${SPL_BINARY}"
part reserved1  --offset 4032   --fixed-size 64K
part reserved2  --offset 4096   --fixed-size 4096K
part loader2    --offset 8192   --fixed-size 4096K            --source rawcopy                                                 --sourceparams="file=u-boot.${UBOOT_SUFFIX}"
part atf        --offset 12288  --fixed-size 4096K
part /boot      --offset 16384  --size       114688K --active --source bootimg-partition --fstype=vfat --label boot --use-uuid --sourceparams="loader=u-boot"
part /                                                        --source rootfs            --fstype=ext4 --label luneos-rootfs --use-uuid

bootloader --ptable gpt --configfile="pinetab2-boot.conf"
```
